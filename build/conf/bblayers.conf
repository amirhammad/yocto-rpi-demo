## build/conf/bblayers.conf
```bitbake
# LAYER_CONF_VERSION is increased each time build/conf/bblayers.conf
# changes incompatibly
POKY_BBLAYERS_CONF_VERSION = "2"

BBPATH = "${TOPDIR}"
BBFILES ?= ""

HOME = "/home/amir/git/amirhammad/meta-rpi-amir"
BBLAYERS ?= " \
    ${HOME}/yocto/poky-jethro/meta \
	${HOME}/yocto/poky-jethro/meta-poky \
    ${HOME}/yocto/poky-jethro/meta-openembedded/meta-oe \
    ${HOME}/yocto/poky-jethro/meta-raspberrypi \
    ${HOME}/build \
  "
#
# ${HOME}/poky-jethro/meta-yocto-bsp 
#    ${HOME}/poky-jethro/meta-openembedded/meta-multimedia 
#    ${HOME}/poky-jethro/meta-openembedded/meta-networking 
#    ${HOME}/poky-jethro/meta-openembedded/meta-python 

BBLAYERS_NON_REMOVABLE ?= " \
    ${HOME}/poky-jethro/meta \
    ${HOME}/poky-jethro/meta-poky \
  "
```

## build/conf/local.conf
```bitbake
# Yocto Project 2.0.1 Poky distribution [jethro] branch
# This is a sysvinit system

LICENSE_FLAGS_WHITELIST = "commercial"

DISTRO_FEATURES_append = " systemd"
DISTRO_FEATURES_remove = "bluetooth bluez5 pcmcia irda xattr zeroconf pci 3g nfs nfc pulseaudio"

PREFERRED_PROVIDER_jpeg = "libjpeg-turbo"
PREFERRED_PROVIDER_jpeg-native = "libjpeg-turbo-native"

PREFERRED_PROVIDER_udev = "systemd"
VIRTUAL_RUNTIME_init_manager = "sysvinit"

MACHINE_FEATURES_remove = "apm"

# IMAGE_FSTYPES = "ext3.lzma"

# the default is 4.1.x
PREFERRED_VERSION_linux-raspberrypi = "4.4.%"
#PREFERRED_VERSION_linux-raspberrypi = "4.5.%"

MACHINE = "raspberrypi2"
DL_DIR = "/media/extended/bbtutori/yocto-files/oe-sources"

SSTATE_DIR = "/media/extended/bbtutori/yocto-files/oe-sstate-cache"

TMPDIR = "/media/extended/bbtutori/yocto-files/oe-tmp"
DEPLOY_DIR = "/media/extended/bbtutori/yocto-files/oe-deploy"

DISTRO = "poky"

PACKAGE_CLASSES = "package_ipk"

DISABLE_OVERSCAN = "1"
DISPMANX_OFFLINE = "1"
ENABLE_SPI_BUS = "1"
ENABLE_I2C_BUS = "1"
ENABLE_RPI_ALSA = "1"
VIDEO_CAMERA = "1"
#ENABLE_RPI3_SERIAL_CONSOLE = "1"

# i686 or x86_64
SDKMACHINE = "x86_64"

EXTRA_IMAGE_FEATURES = "debug-tweaks"

USER_CLASSES = "image-mklibs image-prelink"

PATCHRESOLVE = "noop"

RM_OLD_IMAGE = "1"

CONF_VERSION = "1"

# boot into uBoot
#KERNEL_IMAGETYPE = "uImage"
```
